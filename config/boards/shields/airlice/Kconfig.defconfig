## config/boards/shields/airlice/Kconfig.defconfig
```kconfig
if SHIELD_AIRLICE_LEFT

# Name must be less than 16 characters long!
config ZMK_KEYBOARD_NAME
    default "airlice"

config ZMK_SPLIT_ROLE_CENTRAL
    default y

endif

if SHIELD_AIRLICE_LEFT || SHIELD_AIRLICE_RIGHT

config ZMK_SPLIT
    default y

endif
```

## config/boards/shields/airlice/Kconfig.shield
```kconfig
# No whitespace after the comma or in your part name!
config SHIELD_AIRLICE_LEFT
    def_bool $(shields_list_contains,airlice_left)

# No whitespace after the comma or in your part name!
config SHIELD_AIRLICE_RIGHT
    def_bool $(shields_list_contains,airlice_right)
```
